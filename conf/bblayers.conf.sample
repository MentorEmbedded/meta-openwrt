## conf/bblayers.conf.sample
```bitbake
# LAYER_CONF_VERSION is increased each time build/conf/bblayers.conf
# changes incompatibly
LCONF_VERSION = "5"

BBPATH = "${TOPDIR}"
BBFILES ?= ""

BBLAYERS ?= " \
  ##OEROOT##/meta \
  ##OEROOT##/../meta-oe/meta-python \
  ##OEROOT##/../meta-oe/meta-networking \
  ##OEROOT##/../meta-oe/meta-oe \
  ##OEROOT##/../meta-openwrt \
  "

BBLAYERS_NON_REMOVABLE ?= " \
  ##OEROOT##/meta \
  "
```

## conf/distro/openwrt.conf
```bitbake
DISTRO = "openwrt"
DISTRO_NAME = "Openwrt"
DISTRO_VERSION = "0.0.0"
DISTRO_CODENAME = "experementall"
SDK_VENDOR = "-openwrt"
SDK_VERSION := "${@'${DISTRO_VERSION}'}"

MAINTAINER = "Valentin.Sitdikov@mentor.com"

TARGET_VENDOR = "-openwrt"

LOCALCONF_VERSION = "1"
LAYER_CONF_VERSION ?= "5"

# Override these in poky based distros
OPENWRT_DEFAULT_DISTRO_FEATURES = ""
OPENWRT_DEFAULT_EXTRA_RDEPENDS = "packagegroup-core-boot"
OPENWRT_DEFAULT_EXTRA_RRECOMMENDS = "kernel-module-af-packet"

DISTRO_FEATURES ?= "${DISTRO_FEATURES_DEFAULT} ${DISTRO_FEATURES_LIBC} ${POKY_DEFAULT_DISTRO_FEATURES}"

PREFERRED_VERSION_linux-yocto ?= "3.14%"
PREFERRED_VERSION_linux-yocto_qemux86 ?= "3.14%"
PREFERRED_VERSION_linux-yocto_qemux86-64 ?= "3.14%"
PREFERRED_VERSION_linux-yocto_qemuarm ?= "3.14%"
PREFERRED_VERSION_linux-yocto_qemumips ?= "3.14%"
PREFERRED_VERSION_linux-yocto_qemumips64 ?= "3.14%"
PREFERRED_VERSION_linux-yocto_qemuppc ?= "3.14%"

SDK_NAME = "${DISTRO}-${TCLIBC}-${SDK_ARCH}-${IMAGE_BASENAME}-${TUNE_PKGARCH}"
SDKPATH = "/opt/${DISTRO}/${SDK_VERSION}"

EXTRAOPKGCONFIG = "openwrt-feed-config-opkg"

DISTRO_EXTRA_RDEPENDS += " ${OPENWRT_DEFAULT_EXTRA_RDEPENDS}"
DISTRO_EXTRA_RRECOMMENDS += " ${OPENERT_DEFAULT_EXTRA_RRECOMMENDS}"

OPENWRTQEMUDEPS = "${@base_contains("INCOMPATIBLE_LICENSE", "GPLv3", "", "qemu-config",d)}"
DISTRO_EXTRA_RDEPENDS_append_qemuarm = " ${OPENWRTQEMUDEPS}"
DISTRO_EXTRA_RDEPENDS_append_qemumips = " ${OPENWRTQEMUDEPS}"
DISTRO_EXTRA_RDEPENDS_append_qemuppc = " ${OPENWRTQEMUDEPS}"
DISTRO_EXTRA_RDEPENDS_append_qemux86 = " ${OPENWRTQEMUDEPS}"
DISTRO_EXTRA_RDEPENDS_append_qemux86-64 = " ${OPENWRTQEMUDEPS}"

TCLIBCAPPEND = ""

QEMU_TARGETS ?= "arm i386 mips mipsel ppc x86_64"
# Other QEMU_TARGETS "mips64 mips64el sh4"

PREMIRRORS ??= "\
bzr://.*/.*   http://downloads.yoctoproject.org/mirror/sources/ \n \
cvs://.*/.*   http://downloads.yoctoproject.org/mirror/sources/ \n \
git://.*/.*   http://downloads.yoctoproject.org/mirror/sources/ \n \
hg://.*/.*    http://downloads.yoctoproject.org/mirror/sources/ \n \
osc://.*/.*   http://downloads.yoctoproject.org/mirror/sources/ \n \
p4://.*/.*    http://downloads.yoctoproject.org/mirror/sources/ \n \
svk://.*/.*   http://downloads.yoctoproject.org/mirror/sources/ \n \
svn://.*/.*   http://downloads.yoctoproject.org/mirror/sources/ \n"

MIRRORS =+ "\
ftp://.*/.*      http://downloads.yoctoproject.org/mirror/sources/ \n \
http://.*/.*     http://downloads.yoctoproject.org/mirror/sources/ \n \
https://.*/.*    http://downloads.yoctoproject.org/mirror/sources/ \n"

# The CONNECTIVITY_CHECK_URI's are used to test whether we can succesfully
# fetch from the network (and warn you if not). To disable the test set
# the variable to be empty.
# Git example url: git://git.yoctoproject.org/yocto-firewall-test;protocol=git;rev=HEAD

CONNECTIVITY_CHECK_URIS ?= " \
             https://eula-downloads.yoctoproject.org/index.php \
             http://bugzilla.yoctoproject.org/report.cgi"

SANITY_TESTED_DISTROS ?= " \
            Poky-1.4 \n \
            Poky-1.5 \n \
            Poky-1.6 \n \
            Ubuntu-12.04 \n \
            Ubuntu-13.10 \n \
            Ubuntu-14.04 \n \
            Fedora-19 \n \
            Fedora-20 \n \
            CentOS-6.4 \n \
            CentOS-6.5 \n \
            Debian-7.0 \n \
            Debian-7.1 \n \
            Debian-7.2 \n \
            Debian-7.3 \n \
            Debian-7.4 \n \
            SUSE-LINUX-12.2 \n \
            openSUSE-project-12.3 \n \
            openSUSE-project-13.1 \n \
            "

# Default hash policy for distro
BB_SIGNATURE_HANDLER ?= 'OEBasicHash'
#
# OELAYOUT_ABI allows us to notify users when the format of TMPDIR changes in 
# an incompatible way. Such changes should usually be detailed in the commit
# that breaks the format and have been previously discussed on the mailing list 
# with general agreement from the core team.
#
OELAYOUT_ABI = "8"

# add openwrt sanity bbclass
#INHERIT += "openwrt-sanity"

# QA check settings - a little stricter than the OE-Core defaults
WARN_QA = "textrel files-invalid incompatible-license xorg-driver-abi libdir \
           unknown-configure-option"
ERROR_QA = "dev-so debug-deps dev-deps debug-files arch pkgconfig la perms \
            useless-rpaths rpaths staticdev ldflags pkgvarcheck already-stripped \
            compile-host-path dep-cmp installed-vs-shipped install-host-path \
            packages-list perm-config perm-line perm-link pkgv-undefined \
            pn-overrides split-strip var-undefined version-going-backwards"

export localstatedir = "${base_prefix}/tmp"
```

## conf/layer.conf
```bitbake
# We have a conf and classes directory, add to BBPATH
BBPATH := "${BBPATH}:${LAYERDIR}"

# We have a recipes directory, add to BBFILES
BBFILES := "${BBFILES} ${LAYERDIR}/recipes-core/*/*.bb ${LAYERDIR}/recipes-core/*/*.bbappend \
		${LAYERDIR}/recipes-luci/*/*.bb ${LAYERDIR}/recipes-juci/*/*.bb ${LAYERDIR}/recipes-juci/*/*.bbappend"

BBFILE_COLLECTIONS += "appliance"
BBFILE_PATTERN_appliance := "^${LAYERDIR}/"
BBFILE_PRIORITY_appliance = "1"
```
